/***********************************************************************************************
 ***************************  - SPI_program.c				 		 ***************************
***************************   - Created: 					 ****************************
***************************   - Author : Abdelrahman_Magdy			 ****************************
***************************   - Version: _1_				 		 ****************************
***************************   - Note :
									*-
									*-
 **************************************************************************************/ 


/****************************************************************************************
***************************   The Foundation Of Function   ***************************** 
****************************************************************************************/


/************** INCLUDE LIB **************/
	
		 #include "STD_TYPES.h"
		 #include "BIT_MATH.h"
/*****************************************/	 

/************** INCLUDE MCAL**************/
		#include "SPI_private.h"
		#include "SPI_interface.h"
		#include "SPI_config.h"
/*****************************************/

/************** INCLUDE HALL**************/
			

/*****************************************/

/************** INCLUDEAPP***************/


/*****************************************/

void (* MSPI1_CallBack)(void) = NULL ;

/********************************************************** Start_FUNCTION  **********************************************************/
void MSPI_vInit(u8 Copy_u8SPIIndex)
{
 /* CR1 --> To Config SPI */
	CR1_REG cfg =0 ;
	/* 1- SET PHASE */
	
	/* 2- SET POL  */
	
	/* 3- MASTER OR SLAVE */
	
	/* 4- BUAD RATE */
	
	/* 5- SET SSM  */
	
	/* 6- SET SSI  */
	
	/* 7- DATA_ORDER */
	
	/* 8- DATA_FORMAT*/

	switch (Copy_u8SPIIndex)
	{
		case _SPI_1_ :           break;
		case _SPI_2_ :           break;
		case _SPI_3_ :           break;
		case _SPI_4_ :           break;
		default      :           break;
	} 

}



/*********************************************************** END_ FUNCTION   *********************************************************/

/********************************************************** Start_FUNCTION  **********************************************************/
void MSPI_vEnable(u8 Copy_u8SPIIndex)
{
	switch (Copy_u8SPIIndex)
	{
		case _SPI_1_ :           break;
		case _SPI_2_ :           break;
		case _SPI_3_ :           break;
		case _SPI_4_ :           break;
		default      :           break;
	} 
	
	
}


/*********************************************************** END_ FUNCTION   *********************************************************/


/********************************************************** Start_FUNCTION  **********************************************************/

void MSPI_vDisable(u8 Copy_u8SPIIndex)
{
	switch (Copy_u8SPIIndex)
	{
		case _SPI_1_ :           break;
		case _SPI_2_ :           break;
		case _SPI_3_ :           break;
		case _SPI_4_ :           break;
		default      :           break;
	} 
	
	
}




/*********************************************************** END_ FUNCTION   *********************************************************/


/********************************************************** Start_FUNCTION  **********************************************************/

u16 MSPI1_u16TrasRes(u8 Copy_u8SPIIndex , u16 Copy_u16Data )
{
	/************** STEPS TO FOLLOW *****************
	1. Wait for the BSY bit to reset in Status Register
	2. Send data 
	3. Wait for the RXNE bit to Set in the status Register
	4. Read data from Data Register
	************************************************/
	u16 L_u16Data = 0 ;
	
	
	
}

/*********************************************************** END_ FUNCTION   *********************************************************/


/********************************************************** Start_FUNCTION  **********************************************************/
void MSPI1_vSetCallBack( void (* ptr)(void) )
{
	MSPI1_CallBack = ptr ;
}
/*********************************************************** END_ FUNCTION   *********************************************************/

/********************************************************** Start_FUNCTION  **********************************************************/

void SPI1_IRQHandler(void)
{
	MSPI1_CallBack();	
}

/*********************************************************** END_ FUNCTION   *********************************************************/
